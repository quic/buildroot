## configs/qcom_sa8775_cdsp0_defconfig
```kconfig
BR2_hexagon=y
BR2_HEXAGON_v68=y
BR2_STATIC_LIBS=y
BR2_TOOLCHAIN_EXTERNAL=y
BR2_TOOLCHAIN_EXTERNAL_CUSTOM=y
BR2_TOOLCHAIN_EXTERNAL_CLANG=y
BR2_TOOLCHAIN_EXTERNAL_DOWNLOAD=y
BR2_TOOLCHAIN_EXTERNAL_URL="https://artifacts.codelinaro.org/artifactory/codelinaro-toolchain-for-hexagon/18.1.0-rc1_02/clang+llvm-18.1.0-rc1-cross-hexagon-unknown-linux-musl.tar.xz"
BR2_TOOLCHAIN_EXTERNAL_REL_BIN_PATH="x86_64-linux-gnu/bin"
BR2_TOOLCHAIN_EXTERNAL_CUSTOM_PREFIX="hexagon-unknown-linux-musl"
BR2_TOOLCHAIN_EXTERNAL_CLANG_18_0=y
BR2_TOOLCHAIN_EXTERNAL_HEADERS_6_4=y
BR2_TOOLCHAIN_EXTERNAL_CUSTOM_MUSL=y
BR2_TOOLCHAIN_EXTERNAL_CXX=y
BR2_TARGET_OPTIMIZATION="-Wno-unused-command-line-argument"
BR2_ROOTFS_DEVICE_CREATION_STATIC=y
BR2_TARGET_GENERIC_ROOT_PASSWD="root"
BR2_GLOBAL_PATCH_DIR="board/qcom/sa8775/patches"
BR2_ROOTFS_POST_BUILD_SCRIPT="board/qcom/sa8775/post_build.sh"
BR2_PACKAGE_BUSYBOX_SHOW_OTHERS=y
BR2_PACKAGE_BZIP2=y
BR2_PACKAGE_ZLIB=y
BR2_PACKAGE_LOCKDEV=n
BR2_PACKAGE_LIBEVENT=n
BR2_PACKAGE_ATFTP=n
BR2_PACKAGE_DROPBEAR=y
BR2_PACKAGE_NCURSES=y
BR2_PACKAGE_LSH=y

BR2_PACKAGE_BASH=y
BR2_PACKAGE_ZSH=y

BR2_PACKAGE_XINETD=n
BR2_PACKAGE_COREUTILS=y
BR2_TARGET_ROOTFS_CPIO=y
BR2_TARGET_ROOTFS_CPIO_GZIP=y
BR2_TARGET_ROOTFS_TAR_GZIP=y
```

## package/hexagonMVM/Config.in
```kconfig
config BR2_PACKAGE_HEXAGONMVM
	bool "Hexagon MiniVM"
	depends on BR2_hexagon && BR2_TOOLCHAIN_CLANG_AT_LEAST_19_0
	help
	  Hexagon VM implementation.  This virtual machine can be used
	  to boot linux or other operating systems / programs.

	  https://github.com/quic/hexagonMVM
```

## toolchain/toolchain-external/toolchain-external-hexagon/Config.in
```kconfig
comment "Toolchains available for Hexagon DSP"

config BR2_TOOLCHAIN_EXTERNAL_HEXAGON
	bool "Clang/LLVM Hexagon Toolchain"
	depends on BR2_HOSTARCH = "x86_64" || "aarch64"
	select BR2_TOOLCHAIN_EXTERNAL_CLANG
	select BR2_TOOLCHAIN_EXTERNAL_MUSL
	select BR2_TOOLCHAIN_EXTERNAL_HAS_SSP
```
