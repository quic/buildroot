## configs/qualcomm_qemu_defconfig
```kconfig
BR2_hexagon=y
BR2_HEXAGON_v68=y
BR2_CCACHE=y
BR2_CCACHE_DIR="/local/mnt/workspace/.buildroot-ccache"

BR2_TOOLCHAIN_EXTERNAL=y
BR2_TOOLCHAIN_EXTERNAL_CLANG=y
BR2_TOOLCHAIN_EXTERNAL_CUSTOM=y
BR2_TOOLCHAIN_EXTERNAL_CUSTOM_MUSL=y
BR2_TOOLCHAIN_EXTERNAL_CXX=y

BR2_TOOLCHAIN_EXTERNAL_DOWNLOAD=y
BR2_TOOLCHAIN_EXTERNAL_URL="https://artifacts.codelinaro.org/artifactory/codelinaro-toolchain-for-hexagon/19.1.5/clang+llvm-19.1.5-cross-hexagon-unknown-linux-musl.tar.zst"
BR2_TOOLCHAIN_EXTERNAL_REL_BIN_PATH="x86_64-linux-gnu/bin"
BR2_TOOLCHAIN_EXTERNAL_CUSTOM_PREFIX="hexagon-unknown-linux-musl"
BR2_TOOLCHAIN_EXTERNAL_HEADERS_6_7=y
BR2_TOOLCHAIN_EXTERNAL_CLANG_19_0=y
BR2_WGET="wget -nd -t 3 --connect-timeout=10 --remote-encoding=UTF-8"

BR2_LINUX_KERNEL=y
BR2_TARGET_ROOTFS_INITRAMFS=y
BR2_LINUX_KERNEL_CUSTOM_GIT=y
BR2_LINUX_KERNEL_VMLINUX_BIN=y
BR2_LINUX_KERNEL_CUSTOM_REPO_URL="git@gitlab.qualcomm.com:mathbern/linux.git"
BR2_LINUX_KERNEL_CUSTOM_REPO_VERSION="boot-on-qemu"
BR2_LINUX_KERNEL_DEFCONFIG="qemu"

BR2_TARGET_ROOTFS_CPIO=y
BR2_ROOTFS_DEVICE_CREATION_STATIC=y
BR2_PACKAGE_HEXAGON_H2=y
BR2_PACKAGE_HEXAGON_LINUX_LOADER=y
BR2_PACKAGE_BUSYBOX_SHOW_OTHERS=y
BR2_PACKAGE_BASH=y
BR2_ROOTFS_OVERLAY="board/qualcomm/qemu/ramfs_overlay"
BR2_ROOTFS_POST_BUILD_SCRIPT="board/qualcomm/qemu/copy-libc.sh"
```

## package/hexagon-target-devel/Config.in
```kconfig
config BR2_PACKAGE_HEXAGON_TARGET_DEVEL
	bool "hexagon target devel files (headers, static libs, CRT objects)"
	depends on BR2_hexagon
	depends on BR2_TOOLCHAIN_EXTERNAL_CLANG
	help
	  Installs the C/C++ library development files (musl headers,
	  libc++/libunwind headers, static libraries, compiler-rt runtime
	  libraries and CRT startup objects) from the external toolchain's
	  staging directory onto the target.

	  These files are what let an on-target compiler (e.g.
	  BR2_PACKAGE_CLANG_TARGET_COMPILER) and linker (e.g.
	  BR2_PACKAGE_LLD) actually compile and link code from within the
	  booted rootfs, rather than only being usable as build artifacts
	  of the host build.
```

## package/hexagon_h2/Config.in
```kconfig
config BR2_PACKAGE_HEXAGON_H2
	bool "Hexagon H2"
	depends on BR2_hexagon
	help
	  Hexagon H2 hipervisor. This virtual machine can be used
	  to boot linux or other operating systems / programs.
```

## package/hexagon_linux_loader/Config.in
```kconfig
config BR2_PACKAGE_HEXAGON_LINUX_LOADER
	bool "Hexagon Linux 4.2 Loader"
	depends on BR2_hexagon
	help
	  Hexagon's binary loader for Linux kernel 4.2.
```

## package/hvx-stress/Config.in
```kconfig
config BR2_PACKAGE_HVX_STRESS
	bool "hvx-stress"
	depends on BR2_hexagon
	depends on BR2_HEXAGON_CPU_HAS_HVX
	depends on BR2_TOOLCHAIN_USES_MUSL
	depends on BR2_TOOLCHAIN_HAS_THREADS
	help
	  Stress test for the Hexagon HVX vector unit and for the kernel's
	  HVX coprocessor context management.

	  Provides two workers and a driver script:

	    hvx_kernels     known-answer tests for the HVX datapath, each
	                    checked lane by lane against a scalar reference
	    hvx_ctxsw       parks a unique fingerprint in all 32 vector
	                    registers and Q0-Q3 across many reschedules and
	                    verifies it byte for byte afterwards
	    hvx-stress-run  runs both with more workers than CPUs and
	                    reports one strict pass/fail verdict

	  Intended for validating QEMU's Hexagon HVX emulation and the
	  kernel's context save/restore paths under scheduler pressure.

comment "hvx-stress needs an HVX-capable cpu and a musl toolchain w/ threads"
	depends on BR2_hexagon
	depends on !BR2_HEXAGON_CPU_HAS_HVX || !BR2_TOOLCHAIN_USES_MUSL || \
		!BR2_TOOLCHAIN_HAS_THREADS
```

## package/libc-test/Config.in
```kconfig
config BR2_PACKAGE_LIBC_TEST
	bool "libc-test"
	depends on BR2_TOOLCHAIN_USES_MUSL
	depends on BR2_TOOLCHAIN_HAS_THREADS
	help
	  Rich Felker's libc-test conformance/regression test suite,
	  developed alongside musl. Cross-built only: the host build
	  compiles the functional/math/musl/regression test binaries and
	  installs them under /usr/lib/libc-test/ on the target, but does
	  not execute them (per-test build failures are recorded by the
	  suite's own report mechanism rather than failing the package
	  build). Run them on the target to get PASS/FAIL/BUILDERROR
	  results for this libc/toolchain/kernel combination.

	  http://repo.or.cz/libc-test

comment "libc-test needs a musl toolchain w/ threads"
	depends on !BR2_TOOLCHAIN_USES_MUSL || !BR2_TOOLCHAIN_HAS_THREADS
```

## package/llvm-project/clang/Config.in
```kconfig
config BR2_PACKAGE_CLANG
	bool "clang"
	depends on BR2_PACKAGE_LLVM_ARCH_SUPPORTS
	depends on BR2_TOOLCHAIN_GCC_AT_LEAST_7
	depends on BR2_TOOLCHAIN_HAS_THREADS
	depends on BR2_INSTALL_LIBSTDCPP
	depends on !BR2_TOOLCHAIN_HAS_GCC_BUG_64735 # std::shared_future
	depends on !BR2_STATIC_LIBS
	depends on BR2_USE_WCHAR # std::wstring
	depends on BR2_HOST_GCC_AT_LEAST_7
	select BR2_HOST_CMAKE_AT_LEAST_3_20 # cmake required version at least 3.20
	select BR2_PACKAGE_LLVM
	help
	  Clang is a C/C++, Objective C/C++ and OpenCL C front-end
	  for the LLVM compiler.

	  http://clang.llvm.org

config BR2_PACKAGE_CLANG_TARGET_COMPILER
	bool "install clang as an on-target compiler"
	depends on BR2_PACKAGE_CLANG
	default n
	help
	  By default, clang's compiler binaries and resource directory
	  (compiler-rt/builtins) are removed from the target since there
	  are normally no development files (headers, static libs, linker)
	  available on target to make use of them.

	  Enable this option to keep clang usable as a self-hosted,
	  on-target compiler. You will typically also need a target
	  linker (e.g. BR2_PACKAGE_LLD) and C library development files
	  installed on target for this to be useful.

comment "clang needs a toolchain w/ wchar, threads, C++, gcc >= 7, dynamic library, host gcc >= 7"
	depends on BR2_PACKAGE_LLVM_ARCH_SUPPORTS
	depends on !BR2_TOOLCHAIN_HAS_THREADS || !BR2_INSTALL_LIBSTDCPP || \
		!BR2_TOOLCHAIN_GCC_AT_LEAST_7 \
		|| BR2_STATIC_LIBS || !BR2_USE_WCHAR \
		|| !BR2_HOST_GCC_AT_LEAST_7

comment "clang needs a toolchain not affected by GCC bug 64735"
	depends on BR2_PACKAGE_LLVM_ARCH_SUPPORTS
	depends on BR2_TOOLCHAIN_HAS_GCC_BUG_64735
```

## package/llvm-project/lld/Config.in
```kconfig
config BR2_PACKAGE_LLD
	bool "lld"
	depends on BR2_PACKAGE_LLVM_ARCH_SUPPORTS
	depends on BR2_TOOLCHAIN_GCC_AT_LEAST_7
	depends on BR2_TOOLCHAIN_HAS_THREADS
	depends on BR2_INSTALL_LIBSTDCPP
	depends on !BR2_TOOLCHAIN_HAS_GCC_BUG_64735 # std::shared_future
	depends on !BR2_STATIC_LIBS
	depends on BR2_USE_WCHAR # std::wstring
	depends on BR2_HOST_GCC_AT_LEAST_7
	select BR2_HOST_CMAKE_AT_LEAST_3_20 # cmake required version at least 3.20
	select BR2_PACKAGE_LLVM
	help
	  LLD is a linker from the LLVM project that is a drop-in
	  replacement for system linkers, and runs much faster than
	  them. It also provides features that are useful for
	  toolchain developers.

	  This installs lld/ld.lld as an on-target linker, e.g. for use
	  by an on-target clang (BR2_PACKAGE_CLANG_TARGET_COMPILER).

	  https://lld.llvm.org/

comment "lld needs a toolchain w/ wchar, threads, C++, gcc >= 7, dynamic library, host gcc >= 7"
	depends on BR2_PACKAGE_LLVM_ARCH_SUPPORTS
	depends on !BR2_TOOLCHAIN_HAS_THREADS || !BR2_INSTALL_LIBSTDCPP || \
		!BR2_TOOLCHAIN_GCC_AT_LEAST_7 \
		|| BR2_STATIC_LIBS || !BR2_USE_WCHAR \
		|| !BR2_HOST_GCC_AT_LEAST_7

comment "lld needs a toolchain not affected by GCC bug 64735"
	depends on BR2_PACKAGE_LLVM_ARCH_SUPPORTS
	depends on BR2_TOOLCHAIN_HAS_GCC_BUG_64735
```

## package/opencl-headers/Config.in
```kconfig
config BR2_PACKAGE_OPENCL_HEADERS
	bool "opencl-headers"
	help
	  OpenCL (Open Computing Language) header files from Khronos.

	  https://github.com/KhronosGroup/OpenCL-Headers
```

## package/opencl-icd-loader/Config.in
```kconfig
config BR2_PACKAGE_OPENCL_ICD_LOADER
	bool "opencl-icd-loader"
	depends on !BR2_STATIC_LIBS # dlfcn.h
	depends on BR2_TOOLCHAIN_HAS_THREADS
	select BR2_PACKAGE_OPENCL_HEADERS
	select BR2_PACKAGE_HAS_LIBOPENCL
	help
	  OpenCL Installable Client Driver (ICD) Loader from Khronos.
	  This allows multiple OpenCL implementations to coexist.

	  https://github.com/KhronosGroup/OpenCL-ICD-Loader

config BR2_PACKAGE_PROVIDES_LIBOPENCL
	default "opencl-icd-loader" if BR2_PACKAGE_OPENCL_ICD_LOADER

comment "opencl-icd-loader needs a toolchain w/ dynamic library, threads"
	depends on BR2_STATIC_LIBS || !BR2_TOOLCHAIN_HAS_THREADS
```
